//! AArch64 Linker Script

__page_size = (KERNEL_PAGE_SIZE * 1024);
__virtual_start = VIRT_BASE;
__kernel_start = __virtual_start + KERNEL_BASE;

ENTRY(_start)

SECTIONS
{
  . = __kernel_start;

  .text :
  {
    __text_start = .;

    KEEP(*(.text.boot))
    *(.text)

    . = ALIGN(__page_size);
    __text_end = .;
  }

  .rodata :
  {
    __rodata_start = .;

    *(.rodata)

    . = ALIGN(__page_size);
    __rodata_end = .;
  }

  .data :
  {
    __data_start = .;

    *(.data)

    . = ALIGN(__page_size);
    __data_end = .;
  }

  .bss :
  {
    __bss_start = .;

    bss = .;
    *(.bss .bss.*)

    . = ALIGN(__page_size);
    __bss_end = .;
  }
  
  __bss_size = __bss_end - __bss_start;

  // Reserve space for the kernel stack. Note the reversal of start and end.
  .data.stack :
  {
    __kernel_stack_end = .;
    . += (KERNEL_STACK_PAGES * __page_size);
    __kernel_stack_start = .;
  }

  __kernel_size = __kernel_stack_start - __kernel_start;

  // Reserve three pages for the kernel's bootstrap virtual page table.
  .data.pages :
  {
    __kernel_pages_start = .;
    . += (3 * __page_size);
    __kernel_pages_end = .;
  }

  __kernel_pages_size = __kernel_pages_end - __kernel_pages_start;

  // Reserve three pages for the kernel's bootstrap identity page map. The
  // moment we turn the MMU on, the program counter is still using a physical
  // address. This identity map, loaded into ttbr0_el1, will allow moving to the
  // next instruction which will perform a branch to a virtual address. After
  // that branch, these tables will be discarded. As such, this table must be
  // after __kernel_pages_end so that the kernel can reuse it as it extends the
  // virtual page table.
  .data.id_pages :
  {
    __kernel_id_pages_start = .;
    . += (3 * __page_size);
    __kernel_id_pages_end = .;
  }

  __kernel_id_pages_size = __kernel_id_pages_end - __kernel_id_pages_start;
}
